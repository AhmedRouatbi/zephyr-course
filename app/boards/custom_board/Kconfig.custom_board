## app/boards/custom_board/Kconfig.custom_board
```kconfig
# Copyright 2024 NXP
# SPDX-License-Identifier: Apache-2.0

config BOARD_CUSTOM_BOARD
	select SOC_MCXA156 if BOARD_CUSTOM_BOARD
	select SOC_PART_NUMBER_MCXA156VLL
```

## app/boards/custom_board/board.yml
```yaml
board:
  name: custom_board
  full_name: CUSTOM_BOARD
  vendor: nxp
  socs:
  - name: mcxa156
```

## app/boards/my_board/board.yml
```yaml
board:
  name: my_board
  full_name: MY_BOARD from scratch
  vendor: ar
  socs:
  - name: mcxa156
```
